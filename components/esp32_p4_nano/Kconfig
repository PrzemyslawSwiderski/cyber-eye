## components/esp32_p4_nano/sdkconfig.defaults.board
```kconfig
# Optional: board-specific SDK configuration defaults

#
# Peripheral Support
#
CONFIG_ESP_BOARD_PERIPH_GPIO_SUPPORT=y
CONFIG_ESP_BOARD_PERIPH_I2C_SUPPORT=y
CONFIG_ESP_BOARD_PERIPH_I2S_SUPPORT=y
CONFIG_ESP_BOARD_PERIPH_LDO_SUPPORT=y
CONFIG_ESP_BOARD_PERIPH_SPI_SUPPORT=y
# end of Peripheral Support

#
# Device Support
#
CONFIG_ESP_BOARD_DEV_AUDIO_CODEC_SUPPORT=y
CONFIG_ESP_BOARD_DEV_CAMERA_SUPPORT=y
CONFIG_ESP_BOARD_DEV_CAMERA_SUB_CSI_SUPPORT=y
CONFIG_ESP_BOARD_DEV_CAMERA_SUB_SPI_SUPPORT=y
CONFIG_ESP_BOARD_DEV_FS_FAT_SUPPORT=y
CONFIG_ESP_BOARD_DEV_FS_FAT_SUB_SDMMC_SUPPORT=y
# end of Device Support
```

## luckfox/external/rtl8812eu/Config.in
```kconfig
config BR2_PACKAGE_RTL8812EU
    bool "rtl8812eu"
    depends on BR2_LINUX_KERNEL
    help
      RTL8812EU WiFi driver
```

## main/Kconfig.projbuild
```kconfig
menu "Cyber EYE"

config HTTPD_ENABLE_EVENTS
  bool "Enable ESP_HTTP_SERVER_EVENT"
  default y
  help
    This enables the ESP_HTTP_SERVER_EVENT event type. 
    Generating these eventes adds some overhead. 
    If you are not using this event type, you can disable it to save some memory and add performance.

endmenu
```

## main/old/Kconfig.projbuild
```kconfig
menu "Cyber EYE"

config HTTPD_ENABLE_EVENTS
  bool "Enable ESP_HTTP_SERVER_EVENT"
  default y
  help
    This enables the ESP_HTTP_SERVER_EVENT event type. 
    Generating these eventes adds some overhead. 
    If you are not using this event type, you can disable it to save some memory and add performance.

config VIDEO_STREAM_WIDTH
    int "Video stream width"
    default 800

config VIDEO_STREAM_HEIGHT
    int "Video stream height"
    default 640

config VIDEO_STREAM_FPS
    int "Video stream FPS"
    default 50

endmenu
```
